## conf/machine/ls2080abluebox.conf
```bitbake
#@TYPE: Machine
#@NAME: NXP LS2080A BlueBox
#@SOC: LSCH3
#@DESCRIPTION: Machine configuration for LS2080A in the BlueBox
#@MAINTAINER: consider it GmbH <innovation.support@consider-it.de>

require ls2084abluebox.conf

# Names are slightly different for the older LS2080
RCWNOR = "FFFFPPHH_0x2a_0x41/rcw_ffffpphh_0x2a_0x41_1800_500_1867ddr"
SOC_FAMILY:prepend:ls2080abluebox = "ls2080a:"

# This was taken from BSP34.0.1
UBOOT_CONFIG[tfa] = "ls2084abluebox_tfa_defconfig,,u-boot-dtb.bin"
KERNEL_DEVICETREE = "freescale/fsl-ls2080a-rdb.dtb"

PREFERRED_PROVIDER_virtual/mc-utils = "mc-utils"
PREFERRED_VERSION_mc-utils = "10.20.4"
```

## conf/machine/ls2080ablueboxubuntu.conf
```bitbake
#@TYPE: Machine
#@NAME: NXP BlueBox Classic with Ubuntu rootfs
#@SOC: LSCH3
#@DESCRIPTION: Machine configuration for the BlueBox Classic for Ubuntu
#@MAINTAINER: consider it GmbH <innovation.support@consider-it.de>

# The Ubuntu version of the conf file just resets to the normal conf
# file name, so that we do not have to change compatibility settings
# all over the place.
# <Heinz.Wrobel@nxp.com>
MACHINE="ls2080abluebox"
require conf/machine/ls2080abluebox.conf
EXTRA_IMAGE_FEATURES:append = " empty-root-password"

require conf/machine/include/ubuntubasics.inc
```
